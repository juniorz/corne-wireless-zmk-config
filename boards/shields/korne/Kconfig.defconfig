## boards/shields/korne/Kconfig.defconfig
```kconfig
# either dongle or left can be the central
if SHIELD_KORNE_DONGLE || SHIELD_KORNE_LEFT

config ZMK_SPLIT_ROLE_CENTRAL
    default y

if ZMK_SPLIT_ROLE_CENTRAL

config ZMK_KEYBOARD_NAME
    default "Korne" # max 16 chars

endif # ZMK_SPLIT_ROLE_CENTRAL

endif # SHIELD_KORNE_DONGLE || SHIELD_KORNE_LEFT

# default configuration
if SHIELD_KORNE_DONGLE || SHIELD_KORNE_LEFT || SHIELD_KORNE_RIGHT

config ZMK_SPLIT
    default y

if ZMK_DISPLAY

config I2C
    default y

config SSD1306
    default y

endif # ZMK_DISPLAY

endif # SHIELD_KORNE_DONGLE || SHIELD_KORNE_LEFT || SHIELD_KORNE_RIGHT


# default configuration
if SHIELD_KORNE_LEFT || SHIELD_KORNE_RIGHT

if LVGL

config LV_Z_VDB_SIZE
    default 64

config LV_DPI_DEF
    default 148

config LV_Z_BITS_PER_PIXEL
    default 1

choice LV_COLOR_DEPTH
    default LV_COLOR_DEPTH_1
endchoice

endif # LVGL

endif # SHIELD_KORNE_LEFT || SHIELD_KORNE_RIGHT

# default configuration
if SHIELD_KORNE_DONGLE

if ZMK_DISPLAY

choice ZMK_DISPLAY_WORK_QUEUE
    default ZMK_DISPLAY_WORK_QUEUE_DEDICATED
endchoice

endif # ZMK_DISPLAY

if SSD1306

config LV_Z_VDB_SIZE
    default 64

config LV_DPI_DEF
    default 148

config LV_Z_BITS_PER_PIXEL
    default 1

choice LV_COLOR_DEPTH
    default LV_COLOR_DEPTH_1
endchoice

endif # SSD1306

if ZMK_BACKLIGHT

config PWM
    default y

config LED_PWM
    default y

endif # ZMK_BACKLIGHT

endif # SHIELD_KORNE_DONGLE
```

## config/boards/shields/korne/Kconfig.shield
```kconfig
config SHIELD_KORNE_DONGLE
    def_bool $(shields_list_contains,korne_dongle)

config SHIELD_KORNE_LEFT
    def_bool $(shields_list_contains,korne_left)

config SHIELD_KORNE_RIGHT
    def_bool $(shields_list_contains,korne_right)
```

## config/west.yml
```yaml
manifest:
  defaults:
    revision: v0.2
  remotes:
    - name: zmkfirmware
      url-base: https://github.com/zmkfirmware

    - name: englmaxi
      url-base: https://github.com/englmaxi

    - name: tokyo2006
      url-base: https://github.com/tokyo2006

  projects:
    - name: zmk
      remote: zmkfirmware
      import: app/west.yml

    # modules
    - name: zmk-dongle-display
      remote: englmaxi
      revision: main

    - name: prospeśtor-zmk-module
      remote: tokyo2006
      revision: change_spi2
  self:
    path: config
```
