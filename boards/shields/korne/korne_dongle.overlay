# Reference:
# - https://github.com/englmaxi/zmk-config/blob/main/boards/shields/cosmo/cosmo_dongle.overlay
# - https://github.com/tokyo2006/zmk-corne-dongle/blob/main/config/boards/shields/eyeslash_corne/eyeslash_corne_central_dongle.overlay

#include <dt-bindings/zmk/matrix_transform.h>
#include <layouts/foostan/corne/6column.dtsi>
#include <shields/corne/corne.dtsi>

/ {
    chosen {
        zmk,kscan = &mock_kscan;
        zmk,physical-layout = &foostan_corne_6col_layout;
        zephyr,display = &oled;
    };

    mock_kscan: mock_kscan_0 {
        compatible = "zmk,kscan-mock";
        columns = <0>;
        rows = <0>;
        events = <0>;
    };

/delete-node/ &default_kscan;   // only required if the dongle uses a
                                // different board than the peripherals

#
# https://github.com/tokyo2006/zmk-corne-dongle/blob/fdd4cc2db357146fefd0f602940c2b8a32083fbf/config/boards/shields/eyeslash_corne/eyeslash_corne_central_dongle.overlay#L23C1-L23C11
#

&pinctrl {
    i2c0_default: i2c0_default {
        group1 {
            psels = <NRF_PSEL(TWIM_SDA, 0, 17)>,
                <NRF_PSEL(TWIM_SCL, 0, 20)>;
        };
    };

    i2c0_sleep: i2c0_sleep {
        group1 {
            psels = <NRF_PSEL(TWIM_SDA, 0, 17)>,
                <NRF_PSEL(TWIM_SCL, 0, 20)>;
            low-power-enable;
        };
    };
};

&i2c0 {
	status = "okay";
	compatible = "nordic,nrf-twi";
    pinctrl-0 = <&i2c0_default>;
    pinctrl-1 = <&i2c0_sleep>;
	oled: sh1106@3c {
        compatible = "sinowealth,sh1106";
        reg = <0x3c>;
        width = <129>;
        height = <64>;
        segment-offset = <2>;
        page-offset = <0>;
        display-offset = <0>;
        multiplex-ratio = <63>;
        segment-remap;
        com-invdir;
        inversion-on;
        prechargep = <0x22>;
	};
};
